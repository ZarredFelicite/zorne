/*
 * Copyright (c) 2020 Pete Johanson
 *
 * SPDX-License-Identifier: MIT
 */

#include "ebony.dtsi"

&default_transform {
    col-offset = <6>;
};

/ {
	chosen {
		zmk,kscan = &kscan0;
	};
	kscan0: kscan_0 {
		compatible = "zmk,kscan-gpio-matrix";
		label = "KSCAN1";
		diode-direction = "col2row";
		col-gpios
			= <&xiao_d 6 GPIO_ACTIVE_HIGH>	
			, <&xiao_d 5 GPIO_ACTIVE_HIGH>
			, <&xiao_d 4 GPIO_ACTIVE_HIGH>  
			, <&xiao_d 3 GPIO_ACTIVE_HIGH>  
			, <&xiao_d 2 GPIO_ACTIVE_HIGH> 
			, <&xiao_d 1 GPIO_ACTIVE_HIGH>
			;
		row-gpios
			= <&xiao_d 10 (GPIO_ACTIVE_HIGH | GPIO_PULL_DOWN)>
			, <&xiao_d 9 (GPIO_ACTIVE_HIGH | GPIO_PULL_DOWN)>
			, <&xiao_d 8 (GPIO_ACTIVE_HIGH | GPIO_PULL_DOWN)>
			, <&xiao_d 7 (GPIO_ACTIVE_HIGH | GPIO_PULL_DOWN)>
			;
	};
};
