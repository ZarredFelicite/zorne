/*
 * Copyright (c) 2020 Pete Johanson
 *
 * SPDX-License-Identifier: MIT
 */

#include "ebony.dtsi"

/ {
	chosen {
		zmk,kscan = &kscan;
	};
	kscan: kscan {
		compatible = "zmk,kscan-gpio-matrix";
		label = "KSCAN";
		diode-direction = "col2row";
		col-gpios
			= <&xiao_d 6 GPIO_ACTIVE_HIGH>
			, <&xiao_d 5 GPIO_ACTIVE_HIGH>
			, <&xiao_d 4 GPIO_ACTIVE_HIGH>
			, <&xiao_d 3 GPIO_ACTIVE_HIGH>
			, <&xiao_d 2 GPIO_ACTIVE_HIGH>
			, <&xiao_d 1 GPIO_ACTIVE_HIGH>
			;
		row-gpios
			= <&xiao_d 13 (GPIO_ACTIVE_HIGH | GPIO_PULL_DOWN)>
			, <&xiao_d 12 (GPIO_ACTIVE_HIGH | GPIO_PULL_DOWN)>
			, <&xiao_d 11 (GPIO_ACTIVE_HIGH | GPIO_PULL_DOWN)>
			, <&xiao_d 10 (GPIO_ACTIVE_HIGH | GPIO_PULL_DOWN)>
			;
	};
};
