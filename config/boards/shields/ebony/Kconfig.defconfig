## config/boards/shields/ebony/Kconfig.defconfig
```kconfig
config ZMK_KEYBOARD_NAME
	default "Ebony"

if SHIELD_EBONY_RIGHT

config ZMK_SPLIT_ROLE_CENTRAL
	default y
endif

if SHIELD_EBONY_LEFT || SHIELD_EBONY_RIGHT

config ZMK_SPLIT
	default y
endif
```

## config/boards/shields/ebony/Kconfig.shield
```kconfig
config SHIELD_EBONY_LEFT
	def_bool $(shields_list_contains,ebony_left)

config SHIELD_EBONY_RIGHT
	def_bool $(shields_list_contains,ebony_right)
```

## config/boards/shields/zorne/Kconfig.defconfig
```kconfig
if SHIELD_ZORNE_DONGLE

config ZMK_KEYBOARD_NAME
	default "Zorne"

config ZMK_SPLIT_BLE_ROLE_CENTRAL
	default y
config ZMK_USB
	default y
endif

if SHIELD_ZORNE_LEFT || SHIELD_ZORNE_RIGHT || SHIELD_ZORNE_DONGLE
config ZMK_SPLIT
	default y
config ZMK_BLE
  default y
endif
```

## config/boards/shields/zorne/Kconfig.shield
```kconfig
config SHIELD_ZORNE_LEFT
	def_bool $(shields_list_contains,zorne_left)

config SHIELD_ZORNE_RIGHT
	def_bool $(shields_list_contains,zorne_right)

config SHIELD_ZORNE_DONGLE
	def_bool $(shields_list_contains,zorne_dongle)
```

## config/west.yml
```yaml
manifest:
  remotes:
    - name: mouse
      url-base: https://github.com/paramSonawane
  projects:
    - name: zmk
      remote: mouse
      revision: upstream-mouse-support-linux
      import: app/west.yml
  self:
    path: config
```
